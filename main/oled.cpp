#include "oled.h"
#include "driver/i2c_master.h"
#include "driver/gpio.h"
#include "esp_log.h"
#include <string.h>
#include <stdint.h>

static const char *TAG = "OLED";

#define OLED_SDA     GPIO_NUM_5
#define OLED_SCL     GPIO_NUM_6
#define OLED_ADDR    0x3C
#define OLED_W       72
#define OLED_H       40
#define OLED_PAGES   (OLED_H / 8)   // 5
#define COL_OFFSET   28              // 72-col display centered in 128-col SSD1306

static i2c_master_bus_handle_t s_bus;
static i2c_master_dev_handle_t s_dev;
static uint8_t s_fb[OLED_W * OLED_PAGES];
static uint8_t s_tx[1 + sizeof(s_fb)];  // data prefix + frame buffer

// Standard 5x7 font, ASCII 32-126, 5 bytes per glyph (columns, LSB = top row)
static const uint8_t FONT[][5] = {
    {0x00,0x00,0x00,0x00,0x00}, // ' '
    {0x00,0x00,0x5F,0x00,0x00}, // !
    {0x00,0x07,0x00,0x07,0x00}, // "
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    {0x10,0x08,0x08,0x10,0x08}, // ~
};

static void send_cmd(uint8_t c)
{
    uint8_t buf[2] = {0x00, c};
    i2c_master_transmit(s_dev, buf, 2, 10);
}

bool oled_init(void)
{
    i2c_master_bus_config_t bus_cfg = {
        .i2c_port = I2C_NUM_0,
        .sda_io_num = OLED_SDA,
        .scl_io_num = OLED_SCL,
        .clk_source = I2C_CLK_SRC_DEFAULT,
        .glitch_ignore_cnt = 7,
        .intr_priority = 0,
        .trans_queue_depth = 0,
        .flags = {.enable_internal_pullup = true, .allow_pd = 0},
    };
    esp_err_t err = i2c_new_master_bus(&bus_cfg, &s_bus);
    if (err != ESP_OK) {
        ESP_LOGW(TAG, "I2C bus init failed: %s", esp_err_to_name(err));
        return false;
    }

    i2c_device_config_t dev_cfg = {
        .dev_addr_length = I2C_ADDR_BIT_LEN_7,
        .device_address = OLED_ADDR,
        .scl_speed_hz = 400000,
        .scl_wait_us = 0,
        .flags = {},
    };
    err = i2c_master_bus_add_device(s_bus, &dev_cfg, &s_dev);
    if (err != ESP_OK) {
        ESP_LOGW(TAG, "OLED device add failed: %s", esp_err_to_name(err));
        return false;
    }

    static const uint8_t init_seq[] = {
        0xAE,             // display off
        0xD5, 0x80,       // clock / osc freq
        0xA8, 0x27,       // mux ratio = 39 (40 rows)
        0xD3, 0x00,       // display offset = 0
        0x40,             // start line = 0
        0x8D, 0x14,       // charge pump enable
        0x20, 0x00,       // horizontal addressing mode
        0xA1,             // seg remap (col 127 to SEG0)
        0xC8,             // COM scan remapped (top to bottom)
        0xDA, 0x12,       // COM pins: alternative
        0x81, 0xCF,       // contrast
        0xD9, 0xF1,       // pre-charge
        0xDB, 0x40,       // VCOMH
        0xA4,             // display from RAM
        0xA6,             // normal (not inverted)
        0xAF,             // display on
    };
    for (size_t i = 0; i < sizeof(init_seq); i++)
        send_cmd(init_seq[i]);

    oled_clear();
    oled_flush();
    return true;
}

void oled_clear(void)
{
    memset(s_fb, 0, sizeof(s_fb));
}

void oled_print(int col_px, int page, const char *text)
{
    while (*text && col_px < OLED_W) {
        uint8_t ch = (uint8_t)*text++;
        if (ch < 32 || ch > 126) ch = 32;
        const uint8_t *g = FONT[ch - 32];
        for (int c = 0; c < 5; c++) {
            int x = col_px + c;
            if (x >= 0 && x < OLED_W)
                s_fb[page * OLED_W + x] = g[c];
        }
        col_px += 6;
    }
}

void oled_flush(void)
{
    send_cmd(0x21); send_cmd(COL_OFFSET); send_cmd(COL_OFFSET + OLED_W - 1);
    send_cmd(0x22); send_cmd(0);          send_cmd(OLED_PAGES - 1);

    s_tx[0] = 0x40;
    memcpy(s_tx + 1, s_fb, sizeof(s_fb));
    i2c_master_transmit(s_dev, s_tx, sizeof(s_tx), 100);
}
