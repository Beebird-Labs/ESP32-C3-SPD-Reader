#include "oled.h"
#include "project_config.h"

#include <stdint.h>
#include <string.h>

#include "driver/i2c_master.h"
#include "esp_err.h"
#include "esp_log.h"

static const char *TAG = "OLED";

#define OLED_W 72
#define OLED_H 40
#define OLED_PAGES (OLED_H / 8)
#define COL_OFFSET 28

static i2c_master_bus_handle_t s_bus;
static i2c_master_dev_handle_t s_dev;
static bool s_ready;
static uint8_t s_fb[OLED_W * OLED_PAGES];
static uint8_t s_tx[1 + sizeof(s_fb)];

// Standard 5x7 font, ASCII 32-126, 5 bytes per glyph (columns, LSB = top row)
static const uint8_t FONT[][5] = {
    {0x00, 0x00, 0x00, 0x00, 0x00}, {0x00, 0x00, 0x5F, 0x00, 0x00}, {0x00, 0x07, 0x00, 0x07, 0x00},
    {0x14, 0x7F, 0x14, 0x7F, 0x14}, {0x24, 0x2A, 0x7F, 0x2A, 0x12}, {0x23, 0x13, 0x08, 0x64, 0x62},
    {0x36, 0x49, 0x55, 0x22, 0x50}, {0x00, 0x05, 0x03, 0x00, 0x00}, {0x00, 0x1C, 0x22, 0x41, 0x00},
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    {0x00, 0x41, 0x36, 0x08, 0x00}, {0x10, 0x08, 0x08, 0x10, 0x08},
};

static esp_err_t send_cmd(uint8_t command)
{
    if (!s_dev)
    {
        return ESP_ERR_INVALID_STATE;
    }

    uint8_t buf[2] = {0x00, command};
    return i2c_master_transmit(s_dev, buf, sizeof(buf), 10);
}

bool oled_init(void)
{
    s_ready = false;

    i2c_master_bus_config_t bus_cfg = {
        .i2c_port = I2C_NUM_0,
        .sda_io_num = APP_OLED_SDA,
        .scl_io_num = APP_OLED_SCL,
        .clk_source = I2C_CLK_SRC_DEFAULT,
        .glitch_ignore_cnt = 7,
        .intr_priority = 0,
        .trans_queue_depth = 0,
        .flags = {.enable_internal_pullup = true, .allow_pd = 0},
    };
    esp_err_t err = i2c_new_master_bus(&bus_cfg, &s_bus);
    if (err != ESP_OK)
    {
        ESP_LOGW(TAG, "i2c_bus_init_failed err=%s", esp_err_to_name(err));
        return false;
    }

    err = i2c_master_probe(s_bus, APP_OLED_ADDR, 50);
    if (err != ESP_OK)
    {
        ESP_LOGW(TAG, "oled_probe_failed addr=0x%02x err=%s", APP_OLED_ADDR, esp_err_to_name(err));
        i2c_del_master_bus(s_bus);
        s_bus = NULL;
        return false;
    }

    i2c_device_config_t dev_cfg = {
        .dev_addr_length = I2C_ADDR_BIT_LEN_7,
        .device_address = APP_OLED_ADDR,
        .scl_speed_hz = 400000,
        .scl_wait_us = 0,
        .flags = {},
    };
    err = i2c_master_bus_add_device(s_bus, &dev_cfg, &s_dev);
    if (err != ESP_OK)
    {
        ESP_LOGW(TAG, "oled_device_add_failed err=%s", esp_err_to_name(err));
        i2c_del_master_bus(s_bus);
        s_bus = NULL;
        return false;
    }

    static const uint8_t init_seq[] = {
        0xAE, 0xD5, 0x80, 0xA8, 0x27, 0xD3, 0x00, 0x40, 0x8D, 0x14, 0x20, 0x00, 0xA1,
        0xC8, 0xDA, 0x12, 0x81, 0xCF, 0xD9, 0xF1, 0xDB, 0x40, 0xA4, 0xA6, 0xAF,
    };
    for (size_t i = 0; i < sizeof(init_seq); i++)
    {
        err = send_cmd(init_seq[i]);
        if (err != ESP_OK)
        {
            ESP_LOGW(TAG, "oled_init_command_failed cmd=0x%02x err=%s", init_seq[i], esp_err_to_name(err));
            i2c_master_bus_rm_device(s_dev);
            i2c_del_master_bus(s_bus);
            s_dev = NULL;
            s_bus = NULL;
            return false;
        }
    }

    oled_clear();
    oled_flush();
    s_ready = true;
    return true;
}

void oled_clear(void)
{
    memset(s_fb, 0, sizeof(s_fb));
}

void oled_print(int col_px, int page, const char *text)
{
    if (!s_ready || !text || page < 0 || page >= OLED_PAGES)
    {
        return;
    }

    while (*text && col_px < OLED_W)
    {
        uint8_t ch = (uint8_t)*text++;
        if (ch < 32 || ch > 126)
        {
            ch = 32;
        }
        const uint8_t *glyph = FONT[ch - 32];
        for (int c = 0; c < 5; c++)
        {
            int x = col_px + c;
            if (x >= 0 && x < OLED_W)
            {
                s_fb[page * OLED_W + x] = glyph[c];
            }
        }
        col_px += 6;
    }
}

void oled_flush(void)
{
    if (!s_dev)
    {
        return;
    }

    send_cmd(0x21);
    send_cmd(COL_OFFSET);
    send_cmd(COL_OFFSET + OLED_W - 1);
    send_cmd(0x22);
    send_cmd(0);
    send_cmd(OLED_PAGES - 1);

    s_tx[0] = 0x40;
    memcpy(s_tx + 1, s_fb, sizeof(s_fb));
    i2c_master_transmit(s_dev, s_tx, sizeof(s_tx), 100);
}
